## platform/esp32s3/main/Kconfig.projbuild
```kconfig
menu "MIB-Link"
config MIB_RECOVERY_GPIO
    int "GPIO held low during application startup to use factory settings (-1 disables)"
    range -1 48
    default 4
    help
        Use an otherwise unconnected input-capable pin. GPIO19/20 are reserved
        for native USB. GPIO0 enters the ROM bootloader when held at reset;
        it must not be used for application settings recovery.
endmenu
```

## platform/esp32s3/sdkconfig.defaults
```kconfig
CONFIG_IDF_TARGET="esp32s3"
CONFIG_ESPTOOLPY_FLASHSIZE_4MB=y
CONFIG_ESPTOOLPY_FLASHMODE_DIO=y
CONFIG_ESPTOOLPY_FLASHFREQ_40M=y
CONFIG_PARTITION_TABLE_CUSTOM=y
CONFIG_PARTITION_TABLE_CUSTOM_FILENAME="partitions.csv"
CONFIG_FREERTOS_HZ=1000
CONFIG_ESP_MAIN_TASK_STACK_SIZE=8192
CONFIG_LWIP_TCPIP_TASK_STACK_SIZE=8192
CONFIG_LWIP_TCPIP_CORE_LOCKING=y
CONFIG_LWIP_CHECK_THREAD_SAFETY=y
CONFIG_LWIP_IPV6=n
CONFIG_LWIP_MAX_ACTIVE_TCP=16
CONFIG_LWIP_MAX_LISTENING_TCP=6
CONFIG_LWIP_TCP_SND_BUF_DEFAULT=5840
CONFIG_LWIP_TCP_WND_DEFAULT=5840
CONFIG_LWIP_TCP_QUEUE_OOSEQ=n
CONFIG_LWIP_NETIF_STATUS_CALLBACK=y
CONFIG_ESP_CONSOLE_UART_DEFAULT=y
CONFIG_ESP_CONSOLE_USB_SERIAL_JTAG=n
CONFIG_ESP_CONSOLE_SECONDARY_NONE=y
CONFIG_ESP_WIFI_NVS_ENABLED=n
CONFIG_MIB_RECOVERY_GPIO=4
```
